/*
  OLED Studio v3 - ESP8266 NodeMCU + SH1106 128x64 web controller

  Modes : Writing Board, Video Player, Text Display, Weather, Date & Time (3 styles),
          Timer (countdown / stopwatch), Event Countdown, Scrolling Text, Image, Device Info
  (Rec Playback was removed in v3.)

  Libraries : ESP8266 core (3.x recommended), U8g2
  IDE       : NodeMCU 1.0 (ESP-12E), CPU 160 MHz recommended, Flash 4MB.
  The web page is compiled into the firmware (web_ui.h) - no LittleFS upload needed.
  Brightness, flip, invert, auto-dim, clock style, 12/24 h and the saved event survive reboots (EEPROM).
*/

#include <ESP8266WiFi.h>
#include <ESP8266WebServer.h>
#include <ESP8266mDNS.h>
#include <ArduinoOTA.h>
#include <stddef.h>
#include <EEPROM.h>
#include <Wire.h>
#include <U8g2lib.h>
#include <time.h>
#include <math.h>
#include "credentials.h"
#include "web_ui.h"        // generated by tools/make_web_ui.py

// ---------------------------------------------------------------- configuration
#define ENABLE_MDNS 1                      // http://oledstudio.local (needs Bonjour on Windows 7)
#define ENABLE_OTA  1                      // upload new firmware over Wi-Fi (Tools > Port > oledstudio at 192.168.x.x)
static const char*    MDNS_NAME          = "oledstudio";
static const long     UTC_OFFSET_SECONDS = 19800;        // IST, UTC+05:30
static const int      DST_OFFSET_SECONDS = 0;
static const uint32_t LEASE_MS           = 30000UL;      // browser heartbeats every 5 s (1 s in Timer)
static const uint32_t ANNOUNCE_MS        = 3000UL;
static const uint32_t I2C_CLOCK_HZ       = 400000UL;     // try 100000 if the picture is corrupted
static const uint8_t  MAX_BAD_CODES      = 5;
static const uint32_t LOCKOUT_MS         = 60000UL;
static const size_t   FRAME_BYTES        = 1024;
static const uint16_t MQ_MAX_W           = 640;          // scrolling-text strip: 4 pages (32 px) x up to 640 px
static const uint8_t  MQ_PAGES           = 4;
static const uint8_t  MQ_FIRST_PAGE      = 2;            // rows 16..47
static const uint8_t  DIM_CONTRAST       = 8;

// SH1106 is common on 1.3" modules. For SSD1306 use U8G2_SSD1306_128X64_NONAME_F_HW_I2C.
U8G2_SH1106_128X64_NONAME_F_HW_I2C oled(U8G2_R0, U8X8_PIN_NONE);
ESP8266WebServer server(80);

// ---------------------------------------------------------------- modes
enum Mode : uint8_t { MODE_BOARD, MODE_VIDEO, MODE_TEXT, MODE_WEATHER, MODE_DATETIME,
                      MODE_TIMER, MODE_EVENT, MODE_MARQUEE, MODE_IMAGE, MODE_INFO, MODE_COUNT };
static const char* const MODE_KEYS[]   = { "board", "video", "text", "weather", "datetime",
                                           "timer", "event", "marquee", "image", "info" };
static const char* const MODE_TITLES[] = { "Writing Board", "Video Player", "Text Display", "Weather", "Date & Time",
                                           "Timer", "Event Countdown", "Scrolling Text", "Image", "Device Info" };

// ---------------------------------------------------------------- saved settings (EEPROM)
struct Settings {
  uint16_t magic;
  uint8_t  version;
  uint8_t  contrast;     // 0..255
  uint8_t  flip;         // 0/1  rotate 180 degrees
  uint8_t  invert;       // 0/1  hardware invert
  uint8_t  dimMinutes;   // 0 = never; dims the IP screen after N idle minutes
  uint8_t  clockStyle;   // 0 classic, 1 big, 2 analog
  uint8_t  h12;          // 0 = 24 h, 1 = 12 h
  uint8_t  reserved;
  uint32_t eventTs;      // epoch seconds (IST midnight of the event day); 0 = none
  char     eventTitle[21];
  uint8_t  checksum;
};
Settings cfg;
static const uint16_t CFG_MAGIC = 0xB10D;

uint8_t cfgChecksum(const Settings& s) {
  const uint8_t* p = (const uint8_t*)&s;
  uint8_t sum = 0x5A;
  for (size_t i = 0; i < offsetof(Settings, checksum); i++) sum = (uint8_t)(sum * 31 + p[i]);   // everything before the checksum byte
  return sum;
}
void cfgDefaults() {
  memset(&cfg, 0, sizeof(cfg));
  cfg.magic = CFG_MAGIC; cfg.version = 1; cfg.contrast = 255;
}
void cfgSave() {
  cfg.checksum = cfgChecksum(cfg);
  EEPROM.put(0, cfg);
  EEPROM.commit();
}
void cfgLoad() {
  EEPROM.begin(sizeof(Settings) + 4);
  EEPROM.get(0, cfg);
  bool ok = cfg.magic == CFG_MAGIC && cfg.version == 1 && cfg.checksum == cfgChecksum(cfg) &&
            cfg.flip <= 1 && cfg.invert <= 1 && cfg.clockStyle <= 2 && cfg.h12 <= 1;
  if (!ok) cfgDefaults();
  cfg.eventTitle[sizeof(cfg.eventTitle) - 1] = 0;
}

// ---------------------------------------------------------------- state
String   sessionToken;
Mode     activeMode       = MODE_DATETIME;
uint32_t generation       = 0;
uint32_t lastActivity     = 0;
uint32_t announceUntil    = 0;
bool     modeAnnouncing   = false;
bool     wifiWasConnected = false;
bool     waitingShown     = false;
bool     ipScreenVisible  = false;
bool     needRedraw       = false;       // dynamic modes: draw on the next loop pass
String   pendingText;
int      cursorPosition   = 0;
bool     textModeReady    = false;
int8_t   lastBlinkPhase   = -1;
uint8_t  badCodes         = 0;
uint32_t lockedUntil      = 0;
uint32_t idleSince        = 0;
bool     dimmed           = false;
uint32_t lastSecSeen      = 0;
uint32_t lastSecTry       = 0;

uint8_t  frameBuffer[FRAME_BYTES];

// timer
uint8_t  tType = 1;                      // 0 stopwatch, 1 countdown
bool     tRun = false, tDone = false;
uint32_t tAccum = 0, tStart = 0, tTotal = 300000UL, tDoneAt = 0;
char     tLabel[17] = "TIMER";
uint32_t tSig = 0xFFFFFFFFUL;

// scrolling text strip (page format, stride = mqW)
uint8_t  mqStrip[MQ_PAGES * MQ_MAX_W];
uint16_t mqW = 0;
bool     mqLoaded = false, mqScroll = true, mqNeedFull = true;
int16_t  mqSpeed = 40;                   // px per second, negative = scroll to the right
float    mqPos = 0;
uint32_t mqLast = 0;

// ---------------------------------------------------------------- helpers
static inline bool timeReached(uint32_t deadline) { return (int32_t)(millis() - deadline) >= 0; }

bool parseMode(const String& s, Mode& out) {
  for (uint8_t i = 0; i < MODE_COUNT; i++) if (s == MODE_KEYS[i]) { out = (Mode)i; return true; }
  return false;
}

void sanitizeAscii(const String& in, char* out, size_t cap) {
  size_t n = 0;
  for (size_t i = 0; i < in.length() && n < cap - 1; i++) {
    char c = in[i];
    if (c >= 32 && c < 127 && c != '"' && c != '\\') out[n++] = c;
  }
  out[n] = 0;
}

void applyDisplaySettings() {
  oled.setFlipMode(cfg.flip);
  oled.sendF("c", cfg.invert ? 0xA7 : 0xA6);
  oled.setContrast(dimmed ? DIM_CONTRAST : cfg.contrast);
}

void drawCentered(const char* text, int y) {
  int x = (128 - oled.getStrWidth(text)) / 2;
  if (x < 0) x = 0;
  oled.drawStr(x, y, text);
}

// Choose the biggest font in the list whose text fits in maxW pixels.
void pickFont(const uint8_t* const* fonts, uint8_t n, const char* text, int maxW) {
  for (uint8_t i = 0; i < n; i++) {
    oled.setFont(fonts[i]);
    if (oled.getStrWidth(text) <= maxW) return;
  }
}
static const uint8_t* const BIG_FONTS[] = { u8g2_font_logisoso30_tn, u8g2_font_logisoso24_tn,
                                            u8g2_font_logisoso20_tn, u8g2_font_logisoso16_tn };

void showMessage(const char* line1, const char* line2 = "") {
  oled.clearBuffer();
  oled.setFont(u8g2_font_6x10_tf);
  drawCentered(line1, 27);
  if (line2[0]) drawCentered(line2, 43);
  oled.sendBuffer();
}

void showIp() {
  oled.clearBuffer();
  oled.setFont(u8g2_font_6x10_tf);
  drawCentered("WiFi connected", 18);
  drawCentered(WiFi.localIP().toString().c_str(), 36);
  drawCentered("Open IP in browser", 53);
  oled.sendBuffer();
  ipScreenVisible = true;
}

void showModeName(Mode m) {
  showMessage(MODE_TITLES[m], "Wait for your command");
  modeAnnouncing = true;
  announceUntil = millis() + ANNOUNCE_MS;
  ipScreenVisible = false;
}

bool validClock(struct tm* outTm = nullptr) {
  time_t now = time(nullptr);
  if (now < 1700000000) return false;
  if (outTm) localtime_r(&now, outTm);
  return true;
}

int displayHour(const struct tm& t) {
  if (!cfg.h12) return t.tm_hour;
  int h = t.tm_hour % 12;
  return h ? h : 12;
}

// ---------------------------------------------------------------- clock (3 styles)
static const char* const DAYS[]   = {"SUNDAY","MONDAY","TUESDAY","WEDNESDAY","THURSDAY","FRIDAY","SATURDAY"};
static const char* const DAYS3[]  = {"SUN","MON","TUE","WED","THU","FRI","SAT"};
static const char* const MONTHS[] = {"JAN","FEB","MAR","APR","MAY","JUN","JUL","AUG","SEP","OCT","NOV","DEC"};

void drawClockClassic(const struct tm& t) {
  char date[3], year[5], hour[3], minute[3], second[3];
  snprintf(date, sizeof(date), "%02d", t.tm_mday);
  snprintf(year, sizeof(year), "%04d", t.tm_year + 1900);
  snprintf(hour, sizeof(hour), "%02d", displayHour(t));
  snprintf(minute, sizeof(minute), "%02d", t.tm_min);
  snprintf(second, sizeof(second), "%02d", t.tm_sec);
  oled.setFont(u8g2_font_6x12_tf);
  drawCentered(DAYS[t.tm_wday], 12);
  oled.drawHLine(0, 16, 128);
  const int x1 = 21, x2 = 64, x3 = 107;
  oled.setFont(u8g2_font_5x7_tf);
  oled.drawStr(x1 - oled.getStrWidth("DATE") / 2, 25, "DATE");
  oled.drawStr(x2 - oled.getStrWidth("MONTH") / 2, 25, "MONTH");
  oled.drawStr(x3 - oled.getStrWidth("YEAR") / 2, 25, "YEAR");
  oled.setFont(u8g2_font_6x10_tf);
  oled.drawStr(x1 - oled.getStrWidth(date) / 2, 38, date);
  oled.drawStr(x2 - oled.getStrWidth(MONTHS[t.tm_mon]) / 2, 38, MONTHS[t.tm_mon]);
  oled.drawStr(x3 - oled.getStrWidth(year) / 2, 38, year);
  oled.drawHLine(0, 42, 128);
  const char* hl = !cfg.h12 ? "HOUR" : (t.tm_hour >= 12 ? "HOUR PM" : "HOUR AM");
  oled.setFont(u8g2_font_5x7_tf);
  oled.drawStr(x1 - oled.getStrWidth(hl) / 2, 51, hl);
  oled.drawStr(x2 - oled.getStrWidth("MINUTE") / 2, 51, "MINUTE");
  oled.drawStr(x3 - oled.getStrWidth("SECOND") / 2, 51, "SECOND");
  oled.setFont(u8g2_font_6x10_tf);
  oled.drawStr(x1 - oled.getStrWidth(hour) / 2, 63, hour);
  oled.drawStr(x2 - oled.getStrWidth(minute) / 2, 63, minute);
  oled.drawStr(x3 - oled.getStrWidth(second) / 2, 63, second);
}

void drawClockBig(const struct tm& t) {
  char line[24], hm[8], ss[4];
  snprintf(line, sizeof(line), "%s  %02d %s %04d", DAYS3[t.tm_wday], t.tm_mday, MONTHS[t.tm_mon], t.tm_year + 1900);
  snprintf(hm, sizeof(hm), "%02d:%02d", displayHour(t), t.tm_min);
  snprintf(ss, sizeof(ss), "%02d", t.tm_sec);
  oled.setFont(u8g2_font_6x10_tf);
  drawCentered(line, 10);
  pickFont(BIG_FONTS, 4, hm, 128 - 16);
  int wHm = oled.getStrWidth(hm);
  int x0 = (128 - (wHm + 4 + 12)) / 2;
  if (x0 < 0) x0 = 0;
  oled.drawStr(x0, 48, hm);
  oled.setFont(u8g2_font_6x10_tf);
  oled.drawStr(x0 + wHm + 4, 48, ss);
  if (cfg.h12) oled.drawStr(x0 + wHm + 4, 36, t.tm_hour >= 12 ? "PM" : "AM");
  oled.drawFrame(0, 56, 128, 8);
  oled.drawBox(2, 58, (t.tm_sec * 124) / 59, 4);
}

void drawClockAnalog(const struct tm& t) {
  const int cx = 31, cy = 32, r = 29;
  oled.drawCircle(cx, cy, r);
  for (int i = 0; i < 12; i++) {
    float a = i * 0.5235988f;                       // 30 degrees
    int len = (i % 3 == 0) ? 5 : 2;
    oled.drawLine(cx + (int)roundf(sinf(a) * (r - 1)),   cy - (int)roundf(cosf(a) * (r - 1)),
                  cx + (int)roundf(sinf(a) * (r - len)), cy - (int)roundf(cosf(a) * (r - len)));
  }
  float aS = t.tm_sec * 0.10471976f;                // 6 degrees
  float aM = (t.tm_min + t.tm_sec / 60.0f) * 0.10471976f;
  float aH = ((t.tm_hour % 12) + t.tm_min / 60.0f) * 0.5235988f;
  oled.drawLine(cx, cy, cx + (int)roundf(sinf(aH) * 15), cy - (int)roundf(cosf(aH) * 15));
  oled.drawLine(cx, cy, cx + (int)roundf(sinf(aM) * 22), cy - (int)roundf(cosf(aM) * 22));
  oled.drawLine(cx, cy, cx + (int)roundf(sinf(aS) * 26), cy - (int)roundf(cosf(aS) * 26));
  oled.drawDisc(cx, cy, 2);
  char buf[16];
  oled.setFont(u8g2_font_6x10_tf);
  oled.drawStr(70, 12, DAYS3[t.tm_wday]);
  snprintf(buf, sizeof(buf), "%02d %s", t.tm_mday, MONTHS[t.tm_mon]);
  oled.drawStr(70, 26, buf);
  snprintf(buf, sizeof(buf), "%04d", t.tm_year + 1900);
  oled.drawStr(70, 40, buf);
  if (cfg.h12) snprintf(buf, sizeof(buf), "%02d:%02d %s", displayHour(t), t.tm_min, t.tm_hour >= 12 ? "PM" : "AM");
  else         snprintf(buf, sizeof(buf), "%02d:%02d:%02d", t.tm_hour, t.tm_min, t.tm_sec);
  oled.drawStr(70, 56, buf);
}

void drawClock() {
  struct tm t;
  if (!validClock(&t)) { showMessage("Syncing time...", "Connect to internet"); return; }
  oled.clearBuffer();
  if (cfg.clockStyle == 1) drawClockBig(t);
  else if (cfg.clockStyle == 2) drawClockAnalog(t);
  else drawClockClassic(t);
  oled.sendBuffer();
}

// ---------------------------------------------------------------- timer
uint32_t timerElapsedMs() { return tAccum + (tRun ? millis() - tStart : 0); }

void timerTick() {
  if (tType == 1 && tRun && timerElapsedMs() >= tTotal) {
    tRun = false; tAccum = tTotal; tDone = true; tDoneAt = millis();
  }
}
void timerReset() { tRun = false; tDone = false; tAccum = 0; tSig = 0xFFFFFFFFUL; }
uint32_t timerValueMs() {                     // remaining (countdown) or elapsed (stopwatch)
  uint32_t e = timerElapsedMs();
  if (tType == 1) return e >= tTotal ? 0 : tTotal - e;
  return e;
}

void drawTimer() {
  timerTick();
  uint32_t ms = timerValueMs(), secs = ms / 1000UL;
  unsigned h = secs / 3600UL, m = (secs / 60UL) % 60UL, s = secs % 60UL, tenth = (ms % 1000UL) / 100UL;
  char big[16];
  if (h) snprintf(big, sizeof(big), "%u:%02u:%02u", h, m, s); else snprintf(big, sizeof(big), "%02u:%02u", m, s);
  bool blink = tDone && (millis() - tDoneAt) < 10000UL && ((millis() / 500UL) & 1) == 0;
  oled.clearBuffer();
  if (blink) { oled.drawBox(0, 0, 128, 64); oled.setDrawColor(0); }
  oled.setFont(u8g2_font_6x10_tf);
  oled.drawStr(2, 10, tLabel);
  const char* tag = tDone ? "TIME UP" : (tRun ? (tType ? "RUN" : "RUN") : (timerElapsedMs() ? "PAUSED" : "READY"));
  oled.drawStr(126 - oled.getStrWidth(tag), 10, tag);
  oled.drawHLine(0, 13, 128);
  bool showTenth = (tType == 0 && h == 0);
  pickFont(BIG_FONTS, 4, big, showTenth ? 128 - 16 : 124);
  int wBig = oled.getStrWidth(big);
  int total = wBig + (showTenth ? 14 : 0);
  int x0 = (128 - total) / 2; if (x0 < 0) x0 = 0;
  oled.drawStr(x0, 46, big);
  if (showTenth) {
    char tt[4]; snprintf(tt, sizeof(tt), ".%u", tenth);
    oled.setFont(u8g2_font_6x10_tf);
    oled.drawStr(x0 + wBig + 2, 46, tt);
  }
  oled.setFont(u8g2_font_6x10_tf);
  if (tType == 1) {
    oled.drawFrame(2, 53, 124, 9);
    uint32_t e = tDone ? tTotal : timerElapsedMs();
    int fill = tTotal ? (int)((uint64_t)e * 120 / tTotal) : 0;
    if (fill > 120) fill = 120;
    if (fill > 0) oled.drawBox(4, 55, fill, 5);
  } else {
    drawCentered("STOPWATCH", 62);
  }
  oled.setDrawColor(1);
  oled.sendBuffer();
}

void timerLoop() {
  timerTick();
  uint32_t ms = timerValueMs();
  bool blink = tDone && (millis() - tDoneAt) < 10000UL;
  uint32_t sig = (tType == 0 ? ms / 100UL : ms / 1000UL) * 8 + (tRun ? 1 : 0) + (tDone ? 2 : 0) +
                 (blink ? (((millis() / 500UL) & 1) ? 4 : 0) : 0);
  if (needRedraw || sig != tSig) { needRedraw = false; tSig = sig; drawTimer(); }
}

// ---------------------------------------------------------------- event countdown
void drawEvent() {
  oled.clearBuffer();
  oled.setFont(u8g2_font_6x10_tf);
  if (!cfg.eventTs) {
    drawCentered("No event saved", 27);
    drawCentered("Set date in browser", 43);
    oled.sendBuffer();
    return;
  }
  struct tm t;
  if (!validClock(&t)) { showMessage("Syncing time...", "Connect to internet"); return; }
  int64_t diff = (int64_t)cfg.eventTs - (int64_t)time(nullptr);
  drawCentered(cfg.eventTitle[0] ? cfg.eventTitle : "EVENT", 10);
  oled.drawHLine(0, 14, 128);
  if (diff > 0) {
    unsigned days = (unsigned)(diff / 86400), rem = (unsigned)(diff % 86400);
    char num[8], hms[12];
    snprintf(num, sizeof(num), "%u", days);
    pickFont(BIG_FONTS, 4, num, 80);
    int w = oled.getStrWidth(num);
    int x0 = (128 - (w + 4 + 24)) / 2; if (x0 < 0) x0 = 0;
    oled.drawStr(x0, 48, num);
    oled.setFont(u8g2_font_6x10_tf);
    oled.drawStr(x0 + w + 4, 48, days == 1 ? "DAY" : "DAYS");
    snprintf(hms, sizeof(hms), "%02u:%02u:%02u", rem / 3600, (rem / 60) % 60, rem % 60);
    drawCentered(hms, 62);
  } else {
    unsigned ago = (unsigned)((-diff) / 86400);
    oled.setFont(u8g2_font_7x13B_tf);
    if (ago == 0) drawCentered("IT'S TODAY!", 40);
    else { char b[24]; snprintf(b, sizeof(b), "%u day%s ago", ago, ago == 1 ? "" : "s"); drawCentered(b, 40); }
  }
  oled.sendBuffer();
}

// ---------------------------------------------------------------- device info
void drawInfo() {
  char b[40];
  oled.clearBuffer();
  oled.setFont(u8g2_font_6x10_tf);
  snprintf(b, sizeof(b), "%.21s", WiFi.SSID().c_str());          oled.drawStr(0, 10, b);
  snprintf(b, sizeof(b), "IP %s", WiFi.localIP().toString().c_str()); oled.drawStr(0, 22, b);
  snprintf(b, sizeof(b), "Signal %d dBm", (int)WiFi.RSSI());     oled.drawStr(0, 34, b);
  snprintf(b, sizeof(b), "Free heap %lu KB", (unsigned long)(ESP.getFreeHeap() / 1024)); oled.drawStr(0, 46, b);
  unsigned long u = millis() / 1000UL;
  snprintf(b, sizeof(b), "Up %lud %02luh %02lum", u / 86400UL, (u / 3600UL) % 24UL, (u / 60UL) % 60UL);
  oled.drawStr(0, 58, b);
  oled.sendBuffer();
}

// ---------------------------------------------------------------- text grid (device font)
void drawTextGrid(bool cursorOn) {
  oled.clearBuffer();
  oled.setFont(u8g2_font_5x7_tf);
  for (int i = 0; i < (int)pendingText.length() && i < 105; i++) {
    char ch = pendingText[i];
    if (ch == '\r' || ch == '\n' || ch == '\t') ch = ' ';
    char one[2] = { ch, '\0' };
    oled.drawStr((i % 21) * 6, (i / 21) * 12 + 9, one);
  }
  if (cursorOn) {
    int pos = constrain(cursorPosition, 0, 104);
    oled.drawHLine((pos % 21) * 6, (pos / 21) * 12 + 11, 5);
  }
  oled.sendBuffer();
}

// ---------------------------------------------------------------- scrolling text
void marqueeCopy(uint16_t pos) {
  uint8_t* buf = oled.getBufferPtr();
  for (uint8_t p = 0; p < MQ_PAGES; p++) {
    uint8_t* dst = buf + (MQ_FIRST_PAGE + p) * 128;
    const uint8_t* src = mqStrip + (uint32_t)p * mqW;
    uint16_t s = pos % mqW;
    uint16_t rem = 128;
    while (rem) {
      uint16_t n = mqW - s; if (n > rem) n = rem;
      memcpy(dst, src + s, n);
      dst += n; rem -= n; s += n; if (s >= mqW) s = 0;
    }
  }
}

void marqueeDrawStatic() {
  oled.clearBuffer();
  uint8_t* buf = oled.getBufferPtr();
  uint16_t w = mqW > 128 ? 128 : mqW;
  uint16_t x0 = (128 - w) / 2;
  for (uint8_t p = 0; p < MQ_PAGES; p++) memcpy(buf + (MQ_FIRST_PAGE + p) * 128 + x0, mqStrip + (uint32_t)p * mqW, w);
  oled.sendBuffer();
}

void marqueeStep() {
  uint32_t now = millis();
  if (now - mqLast < 30UL) return;
  uint32_t dt = now - mqLast; mqLast = now;
  mqPos += (float)mqSpeed * dt / 1000.0f;
  while (mqPos >= mqW) mqPos -= mqW;
  while (mqPos < 0) mqPos += mqW;
  if (mqNeedFull) { oled.clearBuffer(); marqueeCopy((uint16_t)mqPos); oled.sendBuffer(); mqNeedFull = false; }
  else { marqueeCopy((uint16_t)mqPos); oled.updateDisplayArea(0, MQ_FIRST_PAGE, 16, MQ_PAGES); }
}

// ---------------------------------------------------------------- mode transitions
void finishModeAnnouncement() {
  modeAnnouncing = false;
  ipScreenVisible = false;
  needRedraw = true;
  switch (activeMode) {
    case MODE_TEXT:    drawTextGrid(true); textModeReady = true; lastBlinkPhase = (millis() / 450) & 1; break;
    case MODE_MARQUEE:
      if (mqLoaded) { if (mqScroll) { mqNeedFull = true; mqLast = millis(); } else marqueeDrawStatic(); }
      else { oled.clearBuffer(); oled.sendBuffer(); }
      break;
    case MODE_DATETIME: case MODE_TIMER: case MODE_EVENT: case MODE_INFO: break;   // loop draws (needRedraw)
    default: oled.clearBuffer(); oled.sendBuffer(); break;                          // wait for browser content
  }
}

// ---------------------------------------------------------------- session
String makeToken() {
  char buf[33];
  snprintf(buf, sizeof(buf), "%08lx%08lx%08lx%08lx",
           (unsigned long)RANDOM_REG32, (unsigned long)RANDOM_REG32,
           (unsigned long)RANDOM_REG32, (unsigned long)ESP.getChipId());
  return String(buf);
}

// Takeover code is DDMMYYHHMM in IST (current NTP minute) or the optional fixed PIN.
bool recoveryCodeMatches(const String& code) {
  if (code.length() < 4) return false;
  for (size_t i = 0; i < code.length(); ++i) if (!isDigit(code[i])) return false;
  if (sizeof(TAKEOVER_PIN) > 1 && code == TAKEOVER_PIN) return true;
  if (code.length() != 10) return false;
  struct tm t;
  if (!validClock(&t)) return false;
  char expected[11];
  snprintf(expected, sizeof(expected), "%02d%02d%02d%02d%02d",
           t.tm_mday, t.tm_mon + 1, (t.tm_year + 1900) % 100, t.tm_hour, t.tm_min);
  return code == expected;
}

void resetSessionContent() {
  pendingText = "";
  textModeReady = false;
  cursorPosition = 0;
  mqLoaded = false;
  timerReset();
  tType = 1; tTotal = 300000UL; strcpy(tLabel, "TIMER");
}

void clearSession(bool showHome) {
  sessionToken = "";
  activeMode = MODE_DATETIME;
  generation++;
  modeAnnouncing = false;
  resetSessionContent();
  idleSince = millis();
  if (showHome && WiFi.status() == WL_CONNECTED) showIp();
}

bool sessionExpired() { return sessionToken.length() && (millis() - lastActivity > LEASE_MS); }

bool hasValidSession() {
  if (!sessionToken.length()) return false;
  if (sessionExpired()) { clearSession(true); return false; }
  if (server.arg("token") != sessionToken) return false;
  lastActivity = millis();
  return true;
}

// ---------------------------------------------------------------- HTTP
void sendJson(int status, const char* body) {
  server.sendHeader("Cache-Control", "no-store");
  server.send(status, "application/json", body);
}
#define REQUIRE_SESSION() do { if (!hasValidSession()) { \
  sendJson(403, "{\"ok\":false,\"error\":\"Session expired or invalid.\"}"); return; } } while (0)

static void jsonStr(String& out, const char* s) {
  out += '"';
  for (; *s; ++s) { char c = *s; if (c == '"' || c == '\\') { out += '\\'; out += c; } else if (c >= 32 && c < 127) out += c; }
  out += '"';
}

void sendState(bool includeToken) {
  String j;
  j.reserve(640);
  j += "{\"ok\":true,\"ip\":\"" + WiFi.localIP().toString() + "\",\"ssid\":";
  jsonStr(j, WiFi.SSID().c_str());
  j += ",\"mode\":\""; j += MODE_KEYS[activeMode];
  j += "\",\"generation\":" + String((unsigned long)generation);
  j += ",\"locked\":"; j += sessionToken.length() ? "true" : "false";
  j += ",\"rssi\":" + String((int)WiFi.RSSI());
  j += ",\"heap\":" + String((unsigned long)ESP.getFreeHeap());
  j += ",\"uptime\":" + String((unsigned long)(millis() / 1000UL));
  j += ",\"ntp\":"; j += validClock() ? "true" : "false";
  j += ",\"fw\":\"3.0\"";
  j += ",\"contrast\":" + String(cfg.contrast) + ",\"flip\":" + String(cfg.flip) + ",\"invert\":" + String(cfg.invert);
  j += ",\"dim\":" + String(cfg.dimMinutes) + ",\"clock\":" + String(cfg.clockStyle) + ",\"h12\":" + String(cfg.h12);
  timerTick();
  j += ",\"tType\":" + String(tType) + ",\"tRun\":"; j += tRun ? "true" : "false";
  j += ",\"tDone\":"; j += tDone ? "true" : "false";
  j += ",\"tVal\":" + String((unsigned long)(timerValueMs() / 1000UL));
  j += ",\"evTs\":" + String((unsigned long)cfg.eventTs) + ",\"evTitle\":";
  jsonStr(j, cfg.eventTitle);
  if (includeToken) j += ",\"token\":\"" + sessionToken + "\"";
  j += "}";
  sendJson(200, j.c_str());
}

void handleRoot() {
  server.sendHeader("Content-Encoding", "gzip");
  server.sendHeader("Cache-Control", "no-store");
  server.send_P(200, "text/html", (PGM_P)WEB_UI, WEB_UI_LEN);
}

void handleAcquire() {
  bool active = sessionToken.length() && !sessionExpired();
  String code = server.arg("code");
  bool recover = false;
  if (active) {
    if (lockedUntil && !timeReached(lockedUntil)) {
      sendJson(429, "{\"ok\":false,\"error\":\"Too many wrong codes. Try again in a minute.\"}");
      return;
    }
    if (code.length()) {
      recover = recoveryCodeMatches(code);
      if (!recover && ++badCodes >= MAX_BAD_CODES) {
        badCodes = 0;
        lockedUntil = millis() + LOCKOUT_MS;
        if (!lockedUntil) lockedUntil = 1;
      }
    }
    if (!recover) {
      sendJson(423, "{\"ok\":false,\"error\":\"Display is controlled by another browser. Enter the current DDMMYYHHMM code to take over.\"}");
      return;
    }
  }
  badCodes = 0;
  lockedUntil = 0;
  sessionToken = makeToken();
  lastActivity = millis();
  generation++;
  activeMode = MODE_DATETIME;          // taking control always starts in Date & Time
  resetSessionContent();
  if (dimmed) { dimmed = false; oled.setContrast(cfg.contrast); }
  showModeName(MODE_DATETIME);
  sendState(true);
}

void handleRelease() {
  REQUIRE_SESSION();
  clearSession(true);
  sendJson(200, "{\"ok\":true}");
}

void handleState() {
  if (sessionExpired()) clearSession(true);
  sendState(false);
}

void handlePing() {
  REQUIRE_SESSION();
  sendState(false);
}

void handleMode() {
  REQUIRE_SESSION();
  Mode m;
  if (!parseMode(server.arg("mode"), m)) { sendJson(400, "{\"ok\":false,\"error\":\"Unknown mode.\"}"); return; }
  generation++;
  activeMode = m;
  pendingText = "";
  textModeReady = false;
  cursorPosition = 0;
  tSig = 0xFFFFFFFFUL;
  showModeName(m);                      // clears whatever the previous mode drew
  sendState(false);
}

void handleSettings() {
  REQUIRE_SESSION();
  bool changed = false;
  if (server.hasArg("contrast")) { cfg.contrast = (uint8_t)constrain(server.arg("contrast").toInt(), 0, 255); changed = true; }
  if (server.hasArg("flip"))     { cfg.flip   = server.arg("flip").toInt() ? 1 : 0; changed = true; }
  if (server.hasArg("invert"))   { cfg.invert = server.arg("invert").toInt() ? 1 : 0; changed = true; }
  if (server.hasArg("dim"))      { cfg.dimMinutes = (uint8_t)constrain(server.arg("dim").toInt(), 0, 120); changed = true; }
  if (server.hasArg("clock"))    { cfg.clockStyle = (uint8_t)constrain(server.arg("clock").toInt(), 0, 2); changed = true; }
  if (server.hasArg("h12"))      { cfg.h12 = server.arg("h12").toInt() ? 1 : 0; changed = true; }
  if (changed) {
    cfgSave();
    applyDisplaySettings();
    needRedraw = true;                  // restyle the clock immediately
  }
  sendState(false);
}

void handleText() {
  REQUIRE_SESSION();
  if (activeMode != MODE_TEXT) { sendJson(403, "{\"ok\":false,\"error\":\"Text mode is not ready.\"}"); return; }
  pendingText = server.arg("plain");
  if (pendingText.length() > 105) pendingText.remove(105);
  cursorPosition = constrain((int)server.arg("cursor").toInt(), 0, 104);
  textModeReady = true;
  modeAnnouncing = false;               // real content ends the announcement at once
  ipScreenVisible = false;
  lastBlinkPhase = (millis() / 450) & 1;
  drawTextGrid(lastBlinkPhase == 0);
  sendJson(200, "{\"ok\":true}");
}

static int hexNibble(char c) {
  if (c >= '0' && c <= '9') return c - '0';
  if (c >= 'a' && c <= 'f') return c - 'a' + 10;
  if (c >= 'A' && c <= 'F') return c - 'A' + 10;
  return -1;
}
static bool decodeHex(const char* p, size_t bytes, uint8_t* out) {
  for (size_t i = 0; i < bytes; i++) {
    int hi = hexNibble(p[i * 2]), lo = hexNibble(p[i * 2 + 1]);
    if (hi < 0 || lo < 0) return false;
    out[i] = (uint8_t)((hi << 4) | lo);
    if ((i & 255) == 255) yield();
  }
  return true;
}

// Body = 2048 hex chars = 1024 bytes in the display's page format (byte = (y>>3)*128 + x, bit = y&7).
void handleFrame() {
  REQUIRE_SESSION();
  Mode requested;
  if (!parseMode(server.arg("mode"), requested) || requested != activeMode ||
      server.arg("gen").toInt() != (long)generation ||
      (activeMode != MODE_BOARD && activeMode != MODE_VIDEO && activeMode != MODE_WEATHER &&
       activeMode != MODE_TEXT && activeMode != MODE_IMAGE)) {
    sendJson(409, "{\"ok\":false,\"error\":\"Stale frame rejected.\"}");
    return;
  }
  const String& hex = server.arg("plain");          // reference: no 2 KB copy
  if (hex.length() != FRAME_BYTES * 2) { sendJson(400, "{\"ok\":false,\"error\":\"Expected 2048 hex characters.\"}"); return; }
  if (!decodeHex(hex.c_str(), FRAME_BYTES, frameBuffer)) { sendJson(400, "{\"ok\":false,\"error\":\"Invalid hex frame.\"}"); return; }
  modeAnnouncing = false;
  ipScreenVisible = false;
  textModeReady = false;                // a bitmap text frame replaces the device-font grid
  memcpy(oled.getBufferPtr(), frameBuffer, FRAME_BYTES);
  oled.sendBuffer();
  sendJson(200, "{\"ok\":true}");
}

// /api/timer?action=set|start|pause|reset  [&type=cd|sw &secs=N &label=TEXT]
void handleTimer() {
  REQUIRE_SESSION();
  if (activeMode != MODE_TIMER) { sendJson(409, "{\"ok\":false,\"error\":\"Timer mode is not active.\"}"); return; }
  String a = server.arg("action");
  timerTick();
  if (a == "set") {
    tType = server.arg("type") == "sw" ? 0 : 1;
    long secs = server.arg("secs").toInt();
    tTotal = (uint32_t)constrain(secs, 1L, 359999L) * 1000UL;
    sanitizeAscii(server.arg("label"), tLabel, sizeof(tLabel));
    if (!tLabel[0]) strcpy(tLabel, tType ? "TIMER" : "STOPWATCH");
    timerReset();
  } else if (a == "start") {
    if (tDone) timerReset();
    if (!tRun) { tStart = millis(); tRun = true; }
  } else if (a == "pause") {
    if (tRun) { tAccum += millis() - tStart; tRun = false; }
  } else if (a == "reset") {
    timerReset();
  } else { sendJson(400, "{\"ok\":false,\"error\":\"Unknown timer action.\"}"); return; }
  modeAnnouncing = false;               // a timer command is real content
  ipScreenVisible = false;
  tSig = 0xFFFFFFFFUL;
  needRedraw = true;
  sendState(false);
}

// /api/event?title=TEXT&ts=EPOCH   (ts = 0 clears the saved event)
void handleEvent() {
  REQUIRE_SESSION();
  long long ts = atoll(server.arg("ts").c_str());
  if (ts < 0 || ts > 4102444800LL) { sendJson(400, "{\"ok\":false,\"error\":\"Bad date.\"}"); return; }
  cfg.eventTs = (uint32_t)ts;
  sanitizeAscii(server.arg("title"), cfg.eventTitle, sizeof(cfg.eventTitle));
  cfgSave();
  if (activeMode == MODE_EVENT) { modeAnnouncing = false; ipScreenVisible = false; needRedraw = true; }
  sendState(false);
}

// /api/marquee?w=PIXELS&speed=PX_PER_S&scroll=0|1   body = 4 pages x w bytes as hex
void handleMarquee() {
  REQUIRE_SESSION();
  if (activeMode != MODE_MARQUEE) { sendJson(409, "{\"ok\":false,\"error\":\"Scrolling text mode is not active.\"}"); return; }
  long w = server.arg("w").toInt();
  if (w < 8 || w > MQ_MAX_W) { sendJson(400, "{\"ok\":false,\"error\":\"Bad strip width.\"}"); return; }
  const String& hex = server.arg("plain");
  size_t bytes = (size_t)w * MQ_PAGES;
  if (hex.length() != bytes * 2) { sendJson(400, "{\"ok\":false,\"error\":\"Strip size mismatch.\"}"); return; }
  if (!decodeHex(hex.c_str(), bytes, mqStrip)) { sendJson(400, "{\"ok\":false,\"error\":\"Invalid hex.\"}"); return; }
  mqW = (uint16_t)w;
  mqSpeed = (int16_t)constrain(server.arg("speed").toInt(), -200L, 200L);
  mqScroll = server.arg("scroll") != "0";
  mqLoaded = true;
  mqPos = 0;
  mqLast = millis();
  modeAnnouncing = false;
  ipScreenVisible = false;
  if (mqScroll) mqNeedFull = true; else marqueeDrawStatic();
  sendJson(200, "{\"ok\":true}");
}

void setupRoutes() {
  server.on("/", HTTP_GET, handleRoot);
  server.on("/api/acquire",  HTTP_POST, handleAcquire);
  server.on("/api/release",  HTTP_POST, handleRelease);
  server.on("/api/state",    HTTP_GET,  handleState);
  server.on("/api/ping",     HTTP_POST, handlePing);
  server.on("/api/mode",     HTTP_POST, handleMode);
  server.on("/api/settings", HTTP_POST, handleSettings);
  server.on("/api/text",     HTTP_POST, handleText);
  server.on("/api/frame",    HTTP_POST, handleFrame);
  server.on("/api/timer",    HTTP_POST, handleTimer);
  server.on("/api/event",    HTTP_POST, handleEvent);
  server.on("/api/marquee",  HTTP_POST, handleMarquee);
  server.onNotFound([]() { server.send(404, "text/plain", "Not found"); });
}

// ---------------------------------------------------------------- setup / loop
uint8_t detectOledAddress() {
  const uint8_t candidates[2] = { 0x3C, 0x3D };
  for (uint8_t i = 0; i < 2; i++) {
    Wire.beginTransmission(candidates[i]);
    if (Wire.endTransmission() == 0) return candidates[i];
  }
  return 0x3C;
}

bool servicesStarted = false;

void startOta() {
#if ENABLE_OTA
  ArduinoOTA.setHostname(MDNS_NAME);
  if (sizeof(OTA_PASSWORD) > 1) ArduinoOTA.setPassword(OTA_PASSWORD);
  ArduinoOTA.onStart([]() { showMessage("Updating firmware", "Do not power off"); });
  ArduinoOTA.onProgress([](unsigned int done, unsigned int total) {
    char b[24]; snprintf(b, sizeof(b), "%u %%", total ? (done * 100U) / total : 0U);
    showMessage("Updating firmware", b);
  });
  ArduinoOTA.onEnd([]() { showMessage("Update complete", "Restarting..."); });
  ArduinoOTA.onError([](ota_error_t) { showMessage("Update failed", "Restarting..."); });
  ArduinoOTA.begin();                               // also starts mDNS under MDNS_NAME
#endif
}

void startNetworkServices() {
  configTime(UTC_OFFSET_SECONDS, DST_OFFSET_SECONDS, "pool.ntp.org", "time.nist.gov");
  if (servicesStarted) return;                      // mDNS / OTA survive a Wi-Fi reconnect
  servicesStarted = true;
#if ENABLE_OTA
  startOta();
  MDNS.addService("http", "tcp", 80);
#elif ENABLE_MDNS
  if (MDNS.begin(MDNS_NAME)) MDNS.addService("http", "tcp", 80);
#endif
}

// True once per wall-clock second (or on demand), used by the 1 Hz modes.
bool secondDue() {
  uint32_t now = millis();
  uint32_t t = (uint32_t)time(nullptr);
  if (needRedraw || (t != lastSecSeen && now - lastSecTry >= 200UL) || now - lastSecTry >= 1000UL) {
    lastSecTry = now; lastSecSeen = t; needRedraw = false;
    return true;
  }
  return false;
}

void setup() {
  Serial.begin(115200);
  cfgLoad();
  Wire.begin(D2, D1);                               // SDA = D2 (GPIO4), SCL = D1 (GPIO5)
  uint8_t addr = detectOledAddress();
  oled.setI2CAddress(addr << 1);
  oled.begin();
  oled.setBusClock(I2C_CLOCK_HZ);
  applyDisplaySettings();
  Serial.printf("\nOLED found at 0x%02X\n", addr);

  showMessage("Waiting for WiFi", "connection...");
  WiFi.mode(WIFI_STA);
  WiFi.setAutoReconnect(true);
  WiFi.begin(WIFI_SSID_VALUE, WIFI_PASSWORD_VALUE);
  while (WiFi.status() != WL_CONNECTED) { delay(100); yield(); }

  startNetworkServices();
  wifiWasConnected = true;
  setupRoutes();
  server.begin();
  idleSince = millis();
  showIp();
  Serial.print("OLED Studio: http://");
  Serial.println(WiFi.localIP());
}

void loop() {
  server.handleClient();
#if ENABLE_OTA
  ArduinoOTA.handle();                              // also calls MDNS.update()
#elif ENABLE_MDNS
  MDNS.update();
#endif

  if (WiFi.status() != WL_CONNECTED) {
    if (wifiWasConnected) {
      wifiWasConnected = false;
      clearSession(false);
      ipScreenVisible = false;
      waitingShown = false;
    }
    if (!waitingShown) { showMessage("Waiting for WiFi", "connection..."); waitingShown = true; }
    delay(50);
    return;
  }
  if (!wifiWasConnected) {
    wifiWasConnected = true;
    waitingShown = false;
    startNetworkServices();
    clearSession(false);
    showIp();
  }

  if (sessionExpired()) clearSession(true);          // lease over -> back to the IP screen

  const bool controlled = sessionToken.length() > 0;

  // Optional auto-dim of the idle IP screen (never turns the display off).
  if (!controlled && cfg.dimMinutes && !dimmed && millis() - idleSince > (uint32_t)cfg.dimMinutes * 60000UL) {
    dimmed = true; oled.setContrast(DIM_CONTRAST);
  } else if (controlled && dimmed) {
    dimmed = false; oled.setContrast(cfg.contrast);
  }

  if (controlled && modeAnnouncing && timeReached(announceUntil)) finishModeAnnouncement();

  if (controlled && !modeAnnouncing) {
    switch (activeMode) {
      case MODE_DATETIME: if (secondDue()) drawClock(); break;
      case MODE_EVENT:    if (secondDue()) drawEvent(); break;
      case MODE_INFO:     if (secondDue()) drawInfo();  break;
      case MODE_TIMER:    timerLoop(); break;
      case MODE_MARQUEE:  if (mqLoaded && mqScroll) marqueeStep(); break;
      case MODE_TEXT:
        if (textModeReady) {                          // redraw only when the cursor phase flips
          int8_t phase = (millis() / 450) & 1;
          if (phase != lastBlinkPhase) { lastBlinkPhase = phase; drawTextGrid(phase == 0); }
        }
        break;
      default: break;                                 // board / video / weather / image: wait for frames
    }
  } else if (!controlled && !ipScreenVisible) {
    showIp();
  }
  delay(1);                                           // lets the Wi-Fi stack breathe
}
